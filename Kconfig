## Kconfig
```kconfig
# Copyright (c) 2026 RAKwireless Technology Limited
# SPDX-License-Identifier: Apache-2.0

rsource "lib/rak3162_runtime/Kconfig"
```

## boards/rak3162/Kconfig.defconfig
```kconfig
# Copyright (c) 2026 RAKwireless Technology Limited
# SPDX-License-Identifier: Apache-2.0

if BOARD_RAK3162_NRF54L15_CPUAPP

config HAS_BT_CTLR
	default BT

config ROM_START_OFFSET
	default 0x800 if BOOTLOADER_MCUBOOT

endif # BOARD_RAK3162_NRF54L15_CPUAPP
```

## boards/rak3162/board.yml
```yaml
# Copyright (c) 2026 RAKwireless Technology Limited
# SPDX-License-Identifier: Apache-2.0

board:
  name: rak3162
  full_name: RAK3162
  vendor: rak
  socs:
  - name: nrf54l15
    variants:
    - name: xip
      cpucluster: cpuflpr
```

## lib/rak3162_runtime/Kconfig
```kconfig
# Copyright (c) 2026 RAKwireless Technology Limited
# SPDX-License-Identifier: Apache-2.0

config RAK3162_RUNTIME
	bool "RAK3162 product platform services"
	depends on RAK_FW
	depends on RAK_AT
	default y if BOARD_RAK3162
	help
	  Board-specific storage, low-power, LED and AT/radio service
	  adapters used by thin RAK3162 applications.
```

## modules/rak-fw/Kconfig
```kconfig
# Copyright (c) 2026 RAKwireless Technology Limited
# SPDX-License-Identifier: Apache-2.0

menuconfig RAK_FW
	bool "RAK firmware framework (AT + LoRa)"
	help
	  External module: RUI3-compatible AT console and LoRaWAN/P2P helpers.

if RAK_FW

config RAK_FW_LORAWAN
	bool "LoRaWAN service library"
	depends on LORAWAN
	default y

config RAK_FW_LORA_P2P
	bool "LoRa P2P service library"
	depends on LORA
	default y

config RAK_AT
	bool "AT command framework (RUI3-compatible)"
	depends on SERIAL
	depends on UART_ASYNC_API
	default y
	help
	  Parser, UART runtime and optional LoRaWAN/P2P AT command façades.

if RAK_AT

config RAK_AT_LORAWAN
	bool "RUI3 LoRaWAN AT commands"
	depends on LORAWAN
	depends on RAK_FW_LORAWAN
	default y

config RAK_AT_LORA_P2P
	bool "RUI3 LoRa P2P AT commands"
	depends on LORA
	depends on RAK_FW_LORA_P2P
	default y

config RAK_AT_UART_LP
	bool "UART low-power enter/exit helpers"
	default y

config RAK_AT_UART_LP_KEEP_RX
	bool "Keep UART async RX during LP (no first-byte loss)"
	depends on RAK_AT_UART_LP
	default n
	help
	  When enabled, AT UART LP does not suspend the console or arm GPIO
	  Sense. UARTE async RX stays active so the first host byte is not
	  lost, but idle current is much higher (measured ~155 µA).
	  Default is n: GPIO Sense wake (~5 µA class); first wake byte may
	  be lost and +EVT:UART_WAKE is emitted.

config RAK_AT_SETTINGS_ROOT
	string "Settings subtree used by product config adapters"
	default "rak3162"

endif # RAK_AT

endif # RAK_FW
```

## modules/rak-fw/tests/util/testcase.yaml
```yaml
# Copyright (c) 2026 RAKwireless Technology Limited
# SPDX-License-Identifier: Apache-2.0

tests:
  rak_fw.util.hex:
    platform_allow:
      - qemu_cortex_m3
    tags:
      - rak_fw
      - util
    integration_platforms:
      - qemu_cortex_m3
```
